## drivers/input/earphone_detection/Kconfig
```kconfig
#
#earphone detection configuration
#

config EARPHONE_DETECTION
	default y
	tristate "earphone detection support"
	help

	say y here if you want earphone support
	
	if not sure say y
```

## drivers/media/video/m6mo/Kconfig
```kconfig
config VIDEO_M6MO
	tristate "Fujisu M6MO MIPI CSI-2 supporting camera driver"
	depends on I2C && VIDEO_V4L2
	---help---
	  This driver supports Fujitsu M6MO ISP with sony IMX175 and OV9724 sensor
```

## drivers/media/video/samsung/mhl/Kconfig
```kconfig
#
# mhl drivers configuration
#

menu "Mhl(sii9244) device support"


config MHL_DRIVER
	bool "MHL driver support."
	depends on VIDEO_TVOUT && (CPU_EXYNOS4412 || CPU_EXYNOS4210)
	default y
	---help---
	  This is a MHL driver for Lenovo TD platform.
	  Check dev node (major 10, minor 244)

#config SAMSUNG_WORKAROUND_HPD_GLANCE
#	bool "To avoid some effect of MHL's HPD glitch"
#	depends on (MHL_DRIVER || MHL_SII9234) && (CPU_EXYNOS4210 || CPU_EXYNOS4212 || #CPU_EXYNOS4412)
#	default y

#config SAMSUNG_MHL_UNPOWERED
#	bool "Use source vbus for mhl dongle if no external power"
#	depends on (SAMSUNG_MHL || MHL_SII9234)
#	default n
endmenu
```

## drivers/modem/Kconfig
```kconfig
menu "Meizu Mobile Modem Interface"

source "drivers/modem/xmm6x60/Kconfig"
source "drivers/modem/sc880xg/Kconfig"

endmenu
```

## drivers/modem/sc880xg/Kconfig
```kconfig
config MEIZU_MODEM_TD
	bool "Meizu TD Mobile Modem Interface"
	default n

config MX2_SC8803G
	bool "TD SC8803G modem chip support"
	depends on MEIZU_MODEM_TD
	default n

config MX2_SC8803G_CONTROL
	bool "TD SC8803G modem control interface"
	depends on MEIZU_MODEM_TD
	default n

config MX2_SC8803G_TEST
	bool "M040 & SC8803G EVT board communication test "
	depends on MEIZU_MODEM_TD
	default n
```

## drivers/modem/xmm6x60/Kconfig
```kconfig
config MEIZU_MODEM_WD
	bool "Meizu WCDMA Mobile Modem Interface"
	default n

config UMTS_MODEM_XMM6160
	bool "modem chip : IFX XMM6160"
	depends on MEIZU_MODEM_WD
	default n

config UMTS_MODEM_XMM6260
	bool "modem chip : IFX XMM6260"
	depends on MEIZU_MODEM_WD
	default n

config UMTS_MODEM_XMM6262
	bool "modem chip : IFX XMM6262"
	depends on MEIZU_MODEM_WD
	default n

config LINK_DEVICE_HSIC
	bool "modem driver link device HSIC"
	depends on MEIZU_MODEM_WD
	default n
```

## sound/soc/audience/Kconfig
```kconfig
config AUDIENCE_A1028
	tristate "A1028 Voice Processor Driver"
	default y
	help
	  Say Y here to enable a1028 voice processor support.

config AUDIENCE_ES305B
	tristate "ES305B Voice Processor Driver"
	default y
	help
	  Say Y here to enable es305b Voice Processor  support.
	  
config  REGULATOR_AUDIO_CRYSTAL
	bool "Regulator for audio crystal "
	depends on MACH_M030 && AUDIENCE_A1028
	help
	  Say Y for use the regulator of audio crystal
```
